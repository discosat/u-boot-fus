/*
 * Copyright (C) 2021 F&S Elektronik Systeme GmbH
 *
 * This program is free software; you can redistribute it and/or modify
 * it under the terms of the GNU General Public License version 2 as
 * published by the Free Software Foundation.
 *
 * This file contains generic NBoot parameters that are included in every
 * BOARD-CFG file. So keep the set as small as possible. Examples are the
 * places where NBoot images (or parts thereof) are stored.
 *
 * We avoid coding these places in the bootloader itself because this would
 * cause problems when something changes. Assume a new NBoot has a different
 * layout where images are stored at different places. Then an old U-Boot with
 * hard coded values would still write the new NBoot to the old positions and
 * the system would fail to boot after that. So it is better to have this
 * information dynamically as part of NBoot. Then U-Boot can look for the right
 * values in the BOARD-CFG and can save everything to the correct (new) places.
 *
 * Some values are only given as placeholders, starting and ending with ###.
 * The Makefile will replace them with their correct values before the file is
 * included in all board configurations.
 *
 * When an NBOOT image is stored, there are three parts that are stored
 * individually:
 *
 *   SPL:       First stage boot loader
 *   BOARD-CFG: This is the configuration for the specific board
 *   FIRMWARE:  This part contains files for DRAM configuration, ATF and TEE
 *
 * For now, BOARD-CFG and FIRMWARE are stored in the same continuous region of
 * the memory. The BOARD-CFG is stored first, starting at the beginning of that
 * region, then with a small gap there is the FIRMWARE. So we only need to know
 * the start of the region, the offset for the FIRMWARE and of course the size
 * of the region.
 *
 *     +-----------+  <--- nboot-start \                 \
 *     | BOARD-CFG |                    |                 |
 *     |-----------|                    | board-cfg-size  |
 *     | (gap)     |                    |                 |
 *     +-----------+                   /                  | nboot-size
 *     | FIRMWARE  |                                      |
 *     +-----------+                                      |
 *     | (free)    |                                      |
 *     +-----------+                                     /
 *
 * SPL is stored separately as required by the ROM loader.
 */

/ {
	nboot-info {
		version = "###NBOOT_VERSION###";

		/*
		 * Settings for NAND: board-cfg-size must aligned to NAND pages
		 * (0x800 bytes = 2 KiB), all other values must be aligned to
		 * NAND blocks (0x20000 bytes = 128 KiB).
		 * 
		 */
		board-cfg-size = <0x2000>;		/* 8 KiB */
		spl-start = <0x00080000 0x00200000>;
		spl-size = <0x00040000>;		/* 256 KiB */
		nboot-start = <###NAND_START###>;
		nboot-size = <0x00140000>;		/* 1280 KiB */
		uboot-start = <0x00500000 0x00800000>;
		uboot-size = <0x00300000>;		/* 3 MiB */
	};
};
