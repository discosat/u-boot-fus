/*
 * Copyright (C) 2021 F&S Elektronik Systeme GmbH
 *
 * This program is free software; you can redistribute it and/or modify
 * it under the terms of the GNU General Public License version 2 as
 * published by the Free Software Foundation.
 */

/dts-v1/;

#include "nboot-info.dtsi"

/ {
	board-cfg {
		board-name = "PicoCoreMX8MN-DDR3L";

		/* DRAM: 256MB Samsung B.ICDRAM.34 */
		dram-type = "ddr3l";
		dram-timing = "ddr3l_k4b2g1646fbym";
		dram-size = <0x100>;		/* In MiB */
		dram-chips = <1>;

		/* Boot-Device: NAND | MMC1/2/3 | SD1/2/3 */
		boot-dev = "NAND";

		/* Fuse settings, fuse-bankword: MSW: Bank, LSW: Fuse-Word */
		fuse-bankword = <0x00010003 0x00020001 0x00020002 0x00020003>;
		fuse-mask =     <0x1000f1c0 0x00780000 0xff00ff00 0x0000fc7f>;
		fuse-value =    <0x10004140 0x00080000 0x00000000 0x00000000>;

		/* Board Features */
		have-nand;
		//have-emmc;
		//have-sgtl5000;
		//have-eth-phy;
		//have-lvds;
		have-mipi-dsi;
		//have-rtc-pcf85063;
		have-rtc-pcf85263;
		//have-security;
		//have-can;
		//have-eeprom;
	};
};
