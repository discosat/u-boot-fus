/*
 * Copyright (C) 2021 F&S Elektronik Systeme GmbH
 *
 * This program is free software; you can redistribute it and/or modify
 * it under the terms of the GNU General Public License version 2 as
 * published by the Free Software Foundation.
 */

/dts-v1/;

#include "nboot-info.dtsi"

/ {
	board-cfg {
		board-name = "PicoCoreMX8MN-LPDDR4";

		/* DRAM: 1GB Samsung */
		dram-type = "lpddr4";
		dram-timing = "lpddr4_k4f8e3s4hd_mgcl";
		dram-size = <0x400>;		/* In MiB */
		dram-chips = <1>;

		/* Boot-Device: NAND | MMC1/2/3 | SD1/2/3 */
		boot-dev = "NAND";

		/* Fuse settings, fuse-bankword: MSW: Bank, LSW: Fuse-Word */
		fuse-bankword = <0x00010003 0x00020001 0x00020002 0x00020003>;
		fuse-mask =     <0x1000f1c0 0x00780000 0xff00ff00 0x0000fc7f>;
		fuse-value =    <0x10004140 0x00080000 0x00000000 0x00000000>;

		/* Board Features */
		have-nand;
		//have-emmc;
		have-sgtl5000;
		have-eth-phy;
		have-wlan;
		have-lvds;
		//have-mipi-dsi;
		have-rtc-pcf85063;
		//have-rtc-pcf85263;
		//have-security;
		//have-can;
		//have-eeprom;
	};
};
