/*
 * Copyright (C) 2021 F&S Elektronik Systeme GmbH
 *
 * This program is free software; you can redistribute it and/or modify
 * it under the terms of the GNU General Public License version 2 as
 * published by the Free Software Foundation.
 */

/dts-v1/;

#include "nboot-info.dtsi"

/ {
	board-cfg {
		board-name = "PicoCoreMX8MM-DDR3L";

		dram-type = "ddr3l";
		dram-timing = "pc-512m1600m2ch2cs";
		dram-size = <0x200>;		/* In MiB */
		dram-chips = <2>;

		/* Boot-Device: NAND | MMC1/2/3 | SD1/2/3 */
		boot-dev = "NAND";
		fuse-bankword = <0x00010003>;	/* MSW: Bank, LSW: Fuse-Word */
		fuse-mask = <0x10007fff>;
		fuse-value = <0x10003700>;

		/* Common board features */
		have-nand;
		//have-emmc;
		have-sgtl5000;
		have-eth-phy;
		//have-lvds;
		have-mipi-dsi;
		//have-rtc-pcf85063;
		have-rtc-pcf85263;
		have-security;
		have-can;
		have-eeprom;

		/* Board-revision specific features */
		PCoreMX8MX-FERT6.110 {
			board-rev = <110>;
		};

		PCoreMX8MX-FERT6.120 {
			board-rev = <120>;
		};
	};
};
