/*
 * Copyright (C) 2021 F&S Elektronik Systeme GmbH
 *
 * This program is free software; you can redistribute it and/or modify
 * it under the terms of the GNU General Public License version 2 as
 * published by the Free Software Foundation.
 */

/dts-v1/;

#include "nboot-info.dtsi"

/ {
	board-cfg {
		board-name = "TBS2";

		/* DRAM: 1GB Intelligent Memory */
		dram-type = "ddr3l";
		dram-timing = "pc-1g1600m2ch2cs";
		dram-size = <0x400>;		/* In MiB */
		dram-chips = <2>;

		/* Boot-Device: NAND | MMC1/2/3 | SD1/2/3 */
		boot-dev = "MMC3";
		fuse-bankword = <0x00010003>;	/* MSW: Bank, LSW: Fuse-Word */
		fuse-mask = <0x10007fff>;
		fuse-value = <0x10002800>;

		/* Board Features */
		board-rev = <120>;
		//have-nand;
		have-emmc;
		//have-sgtl5000;
		have-eth-phy;
		have-wlan;
		//have-lvds;
		have-mipi-dsi;
		//have-rtc-pcf85063;
		have-rtc-pcf85263;
		//have-security;
		//have-can;
		have-eeprom;
	};
};
