/*
 * Copyright (C) 2021 F&S Elektronik Systeme GmbH
 *
 * This program is free software; you can redistribute it and/or modify
 * it under the terms of the GNU General Public License version 2 as
 * published by the Free Software Foundation.
 */

/dts-v1/;

#include ".nboot-info-nand.dtsi.tmp"

/ {
	board-cfg {
		board-cfg-version = <1>;	/* Increment on changes */  
		board-name = "PicoCoreMX8MM";
		board-rev = <110>;		/* Rev 1.10 */

		/* DRAM: 1GB Samsung (different to Rev. 1.00!) */
		dram-type = "lpddr4";
		dram-timing = "lpddr4_k4f8e3s4hd_mgcl";
		dram-size = <0x400>;		/* In MiB */
		dram-chips = <1>;

		/* Boot-Device: NAND | MMC1/2/3 | SD1/2/3 */
		boot-dev = "NAND";
		fuse-bankword = <0x00010003>;	/* MSW: Bank, LSW: Fuse-Word */
		fuse-mask = <0x10007fff>;
		fuse-value = <0x10003700>;

		/* Board Features */
		have-nand;
		//have-emmc;
		have-sgtl5000;
		have-eth-phy;
		//have-wlan;
		have-lvds;
		//have-1x-mipi-dsi;
		//have-ext-rtc;
		//have-security;
		//have-can;
		//have-eeprom;
	};
};
