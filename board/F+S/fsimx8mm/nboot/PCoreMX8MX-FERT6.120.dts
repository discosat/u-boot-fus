/*
 * Copyright (C) 2021 F&S Elektronik Systeme GmbH
 *
 * This program is free software; you can redistribute it and/or modify
 * it under the terms of the GNU General Public License version 2 as
 * published by the Free Software Foundation.
 */

/dts-v1/;

/ {
	board-cfg {
		board-cfg-version = <1>;	/* Increment on changes */  
		board-name = "PicoCoreMX8MX";
		board-rev = <120>;		/* Rev 1.20 */

		/* DRAM: 512MB Micron */
		dram-type = "ddr3l";
		dram-timing = "ddr3l_2x_mt41k128m16tw";
		dram-size = <0x20000000>;
		dram-chips = <2>;

		/* Boot-Device: NAND | MMC1/2/3 | SD1/2/3 */
		boot-dev = "NAND";

		/* Board Features */
		have-nand;
		//have-emmc;
		have-sgtl5000;
		have-eth-switch;
		//have-lvds;
		have-mipi-dsi;
		have-ext-rtc;
		have-security;
		have-can;
		have-eeprom;
	};
};
