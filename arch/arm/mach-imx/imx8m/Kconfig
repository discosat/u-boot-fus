## arch/arm/mach-imx/imx8m/Kconfig
```kconfig
if ARCH_IMX8M

config IMX8M
	bool
	select HAS_CAAM
	select ROM_UNIFIED_SECTIONS

config IMX8MQ
	bool
	select IMX8M

config IMX8MM
	bool
	select IMX8M

config IMX8MN
	bool
	select IMX8M

choice
	prompt	"NXP i.MX8M board select"
	optional

config TARGET_IMX8MQ_EVK
	bool "imx8mq_evk"
	select IMX8MQ
	select SUPPORT_SPL
	select IMX8M_LPDDR4

config TARGET_IMX8MQ_DDR3L_ARM2
	bool "imx8mq_ddr3l_arm2"
	select IMX8MQ
	select SUPPORT_SPL

config TARGET_IMX8MQ_DDR4_ARM2
	bool "imx8mq_ddr4_arm2"
	select IMX8MQ
	select SUPPORT_SPL

config TARGET_IMX8MQ_PHANBELL
	bool "imx8mq_phanbell"
	select IMX8MQ
	select SUPPORT_SPL

config TARGET_IMX8MQ_AIY
	bool "imx8mq_aiy"
	select IMX8MQ
	select SUPPORT_SPL
	select IMX8M_LPDDR4

config TARGET_IMX8MM_DDR4_VAL
	bool "imx8mm DDR4 validation board"
	select IMX8MM
	select SUPPORT_SPL
	select IMX8M_DDR4

config TARGET_IMX8MM_DDR3L_VAL
	bool "imx8mm DDR3L validation board"
	select IMX8MM
	select SUPPORT_SPL
	select IMX8M_DDR3L

config TARGET_IMX8MM_EVK
	bool "imx8mm LPDDR4 EVK board"
	select IMX8MM
	select SUPPORT_SPL
	select IMX8M_LPDDR4

config TARGET_IMX8MM_DDR4_EVK
	bool "imx8mm DDR4 EVK board"
	select IMX8MM
	select SUPPORT_SPL
	select IMX8M_DDR4

config TARGET_IMX8MN_EVK
	bool "imx8mn LPDDR4 EVK board"
	select IMX8MN
	select SUPPORT_SPL
	select IMX8M_LPDDR4

config TARGET_IMX8MN_DDR4_EVK
	bool "imx8mn DDR4 EVK board"
	select IMX8MN
	select SUPPORT_SPL
	select IMX8M_DDR4

config TARGET_FSIMX8MM
	bool "Support fsimx8mm boards from F&S"
	select IMX8MM
	select SUPPORT_SPL
	select IMX8M_LPDDR4
	select IMX8M_DDR3L

config TARGET_FSIMX8M
	bool "Support fsimx8m boards from F&S"
	select IMX8MQ
	select SUPPORT_SPL
	select IMX8M_LPDDR4

config TARGET_FSIMX8MN
	bool "Support fsimx8mn boards from F&S"
	select IMX8MN
	select SUPPORT_SPL
	select IMX8M_LPDDR4

config TARGET_FSIMX8MX
	bool "Support fsimx8mx boards from F&S"
	select IMX8MM
	select SUPPORT_SPL
	select IMX8M_LPDDR3

config TARGET_FSIMX8MX_NANO
	bool "Support fsimx8mx boards from F&S"
	select IMX8MN
	select SUPPORT_SPL
	select IMX8M_LPDDR3

config TARGET_TBS2
	bool "Support tbs2 boards from F&S"
	select IMX8MM
	select SUPPORT_SPL
	select IMX8M_LPDDR3
	select IMX8M_LPDDR4

endchoice

config SYS_SOC
	default "imx8m"

source "board/freescale/imx8mq_evk/Kconfig"
source "board/freescale/imx8mq_arm2/Kconfig"
source "board/freescale/imx8mq_phanbell/Kconfig"
source "board/freescale/imx8mq_aiy/Kconfig"
source "board/freescale/imx8mm_evk/Kconfig"
source "board/freescale/imx8mm_val/Kconfig"
source "board/freescale/imx8mn_evk/Kconfig"
source "board/F+S/fsimx8mm/Kconfig"
source "board/F+S/fsimx8m/Kconfig"
source "board/F+S/fsimx8mn/Kconfig"
source "board/F+S/fsimx8mx/Kconfig"
source "board/F+S/fsimx8mx_nano/Kconfig"
source "board/F+S/tbs2/Kconfig"

endif
```

## board/F+S/common/Kconfig
```kconfig
if TARGET_FSVYBRID || TARGET_FSIMX6 || TARGET_FSIMX6SX || TARGET_FSIMX6UL || TARGET_FSIMX7ULP || TARGET_FSIMX8M || TARGET_FSIMX8MM || TARGET_FSIMX8MN || TARGET_FSIMX8MP || TARGET_FSIMX8X

config ETHADDR_BASE
	string
	default "00:05:51:07:55:83"

config ADDFSHEADER
	bool
	default y

config FS_BOARD_COMMON
	bool
	default y

config FS_BOARD_OFFS
	int
	default 16 if TARGET_FSIMX6UL
	default 8  if TARGET_FSIMX6SX
	default 0

config FS_BOARD_MODE_RO
	bool "Load rootfs read-only (F&S)"
	default y
	help
	  F&S boards usually start the rootfs in read-only mode to
	  avoid any data loss when the power fails or when the board is
	  simply switched off without a proper shutdown procedure. If
	  you want a writable rootfs instead, say N here. But be warned,
	  this may be dangerous for your data!

config FS_IMAGE_COMMON
	bool
	default y if TARGET_FSIMX8MM || TARGET_FSIMX8MN || TARGET_FSIMX8MP || TARGET_FSIMX8X

config FS_DRAM_COMMON
	bool
	default y if TARGET_FSIMX8MM || TARGET_FSIMX8MN || TARGET_FSIMX8MP || TARGET_FSIMX8X

config FS_FDT_COMMON
	bool
	default y

config FS_MMC_COMMON
	bool
	default y if TARGET_FSIMX6 || TARGET_FSIMX6SX || TARGET_FSIMX6UL || TARGET_FSIMX7ULP || TARGET_FSIMX8MM || TARGET_FSIMX8MN || TARGET_FSIMX8MP

config FS_ETH_COMMON
	bool
	default y if TARGET_FSIMX6 || TARGET_FSIMX6SX || TARGET_FSIMX6UL || TARGET_FSIMX8MM || TARGET_FSIMX8MN || TARGET_FSIMX8MP || TARGET_FSIMX8X

config FS_USB_COMMON
	bool
	default y if TARGET_FSIMX6 || TARGET_FSIMX6SX || TARGET_FSIMX6UL

config FS_USB_PWR_USBNC
	bool "Use USB PWR function from host controller"
	depends on FS_USB_COMMON
	default y
	help
	  The VBUS power for a USB host port can either be switched
	  automatically in hardware by the dedicated USB controller
	  function or manually by setting the pad as a GPIO. If you
	  say N, the code will use the GPIO variant, if you say Y,
	  the dedicated controller function will be used where possible.

config FS_SPL_MEMTEST_COMMON
	bool "Activate memory test in SPL"
	depends on TARGET_FSIMX8MP
	select SPL_CACHE_SUPPORT
	select LIB_RAND
	default n
	help
        Run a DRAM test in SPL. The board will have to be resettet after
        the test.

config FS_DISP_COMMON
	bool
	default y if TARGET_FSIMX6 || TARGET_FSIMX6SX || TARGET_FSIMX6UL

config FS_DISP_COUNT
	int
	depends on FS_DISP_COMMON
	default 4 if TARGET_FSIMX6
	default 2 if TARGET_FSIMX6SX
	default 1 if TARGET_FSIMX6UL

config USB_TCPC
	bool "USB Typec port controller simple driver"
	default n if TARGET_FSIMX8MP
	help
	  Enable USB type-c port controller (TCPC) driver


endif
```

## board/F+S/fsimx6/Kconfig
```kconfig
if TARGET_FSIMX6

config SYS_CPU
	default "armv7"

config SYS_BOARD
	default "fsimx6"

config SYS_VENDOR
	default "F+S"

config SYS_SOC
	default "mx6"

config SYS_CONFIG_NAME
	default "fsimx6"

endif
```

## board/F+S/fsimx6sx/Kconfig
```kconfig
if TARGET_FSIMX6SX

config SYS_CPU
	default "armv7"

config SYS_BOARD
	default "fsimx6sx"

config SYS_VENDOR
	default "F+S"

config SYS_SOC
	default "mx6"

config SYS_CONFIG_NAME
	default "fsimx6sx"

endif
```

## board/F+S/fsimx6ul/Kconfig
```kconfig
if TARGET_FSIMX6UL

config SYS_CPU
	default "armv7"

config SYS_BOARD
	default "fsimx6ul"

config SYS_VENDOR
	default "F+S"

config SYS_SOC
	default "mx6"

config SYS_CONFIG_NAME
	default "fsimx6ul"

endif
```

## board/F+S/fsimx7ulp/Kconfig
```kconfig
if TARGET_FSIMX7ULP

config SYS_BOARD
	default "fsimx7ulp"

config SYS_VENDOR
	default "F+S"

config SYS_CONFIG_NAME
	default "fsimx7ulp"

endif
```

## board/F+S/fsimx8m/Kconfig
```kconfig
if TARGET_FSIMX8M

config SYS_BOARD
	default "fsimx8m"

config SYS_VENDOR
	default "F+S"

config SYS_SOC
	default "mx8m"

config SYS_CONFIG_NAME
	default "fsimx8m"
	  
source "board/freescale/common/Kconfig"

endif
```

## board/F+S/fsimx8mm/Kconfig
```kconfig
if TARGET_FSIMX8MM

config SYS_BOARD
	default "fsimx8mm"

config SYS_VENDOR
	default "F+S"

config SYS_CONFIG_NAME
	default "fsimx8mm"

source "board/freescale/common/Kconfig"

endif
```

## board/F+S/fsimx8mn/Kconfig
```kconfig
if TARGET_FSIMX8MN

config SYS_BOARD
	default "fsimx8mn"

config SYS_VENDOR
	default "F+S"

config SYS_CONFIG_NAME
	default "fsimx8mn"

source "board/freescale/common/Kconfig"

endif
```

## board/F+S/fsimx8mp/Kconfig
```kconfig
if TARGET_FSIMX8MP

config SYS_BOARD
	default "fsimx8mp"

config SYS_VENDOR
	default "F+S"

config SYS_CONFIG_NAME
	default "fsimx8mp"

source "board/freescale/common/Kconfig"

endif
```

## board/F+S/fsimx8mx/Kconfig
```kconfig
if TARGET_FSIMX8MX

config SYS_BOARD
	default "fsimx8mx"

config SYS_VENDOR
	default "F+S"

config SYS_CONFIG_NAME
	default "fsimx8mx"

source "board/freescale/common/Kconfig"

endif
```

## board/F+S/fsimx8mx_nano/Kconfig
```kconfig
if TARGET_FSIMX8MX_NANO

config SYS_BOARD
	default "fsimx8mx_nano"

config SYS_VENDOR
	default "F+S"

config SYS_CONFIG_NAME
	default "fsimx8mx_nano"

source "board/freescale/common/Kconfig"

endif
```

## board/F+S/fsimx8x/Kconfig
```kconfig
if TARGET_FSIMX8X

config SYS_BOARD
	default "fsimx8x"

config SYS_VENDOR
	default "F+S"

config SYS_CONFIG_NAME
	default "fsimx8x"

endif
```

## board/F+S/fsvybrid/Kconfig
```kconfig
if TARGET_FSVYBRID

config SYS_CPU
	default "armv7"

config SYS_BOARD
	default "fsvybrid"

config SYS_VENDOR
	default "F+S"

config SYS_SOC
	default "vybrid"

config SYS_CONFIG_NAME
	default "fsvybrid"

endif
```

## board/F+S/tbs2/Kconfig
```kconfig
if TARGET_TBS2

config SYS_BOARD
	default "tbs2"

config SYS_VENDOR
	default "F+S"

config SYS_CONFIG_NAME
	default "tbs2"

source "board/freescale/common/Kconfig"

endif
```

## configs/fsimx6_defconfig
```kconfig
CONFIG_ARM=y
CONFIG_SYS_THUMB_BUILD=y
# CONFIG_SPL_SYS_THUMB_BUILD is not set
CONFIG_ARCH_MX6=y
CONFIG_SYS_TEXT_BASE=0x10100000
CONFIG_TARGET_FSIMX6=y
CONFIG_IDENT_STRING=" for F&S"
CONFIG_OF_BOARD_SETUP=y
CONFIG_SYS_EXTRA_OPTIONS="IMX_CONFIG=board/F+S/fsimx6/fsimx6image.cfg"
# CONFIG_SET_BOOTDELAY is not set
CONFIG_USE_BOOTARGS=y
CONFIG_BOOTARGS="undef"
# CONFIG_CONSOLE_MUX is not set
CONFIG_SYS_CONSOLE_IS_IN_ENV=y
CONFIG_SYS_CONSOLE_ENV_OVERWRITE=y
CONFIG_HUSH_PARSER=y
CONFIG_CMD_BOOTZ=y
# CONFIG_CMD_ELF is not set
CONFIG_CMD_ASKENV=y
CONFIG_CMD_INI=y
CONFIG_CMD_ENV_CALLBACK=y
CONFIG_CMD_ENV_FLAGS=y
CONFIG_CMD_MEMTEST=y
CONFIG_CMD_UNZIP=y
# CONFIG_CMD_FLASH is not set
CONFIG_CMD_I2C=y
# CONFIG_CMD_LOADB is not set
# CONFIG_CMD_LOADS is not set
CONFIG_CMD_MMC=y
CONFIG_CMD_NAND=y
CONFIG_CMD_READ=y
CONFIG_CMD_USB=y
CONFIG_CMD_UPDATE=y
CONFIG_CMD_DHCP=y
CONFIG_CMD_MII=y
CONFIG_CMD_PING=y
CONFIG_CMD_CACHE=y
CONFIG_CMD_GETTIME=y
CONFIG_CMD_TIMER=y
CONFIG_CMD_EXT2=y
CONFIG_CMD_EXT4=y
CONFIG_CMD_FAT=y
CONFIG_CMD_FS_GENERIC=y
CONFIG_MTDIDS_DEFAULT="undef"
CONFIG_MTDPARTS_DEFAULT="undef"
CONFIG_CMD_UBI=y
CONFIG_ENV_IS_IN_NAND=y
CONFIG_NETCONSOLE=y
CONFIG_BOOTP_BOOTPATH=y
CONFIG_BOOTP_DNS=y
CONFIG_BOOTP_GATEWAY=y
CONFIG_BOOTP_HOSTNAME=y
CONFIG_BOOTP_SUBNETMASK=y
CONFIG_SYS_I2C_MXC=y
CONFIG_LED_STATUS0=y
CONFIG_LED_STATUS_BIT=0
CONFIG_LED_STATUS1=y
CONFIG_LED_STATUS_BIT1=1
CONFIG_LED_STATUS_CMD=y
CONFIG_MXC_OCOTP=y
CONFIG_NAND=y
CONFIG_NAND_MXS_FUS=y
CONFIG_NAND_REFRESH=y
CONFIG_PHYLIB=y
CONFIG_PHY_ATHEROS=y
CONFIG_PHY_NATSEMI=y
CONFIG_NETDEVICES=y
CONFIG_DRIVER_AX88796=y
CONFIG_DRIVER_AX88796_BASE=0x0c000000
CONFIG_FEC_MXC=y
CONFIG_MXC_UART=y
CONFIG_BLINK_IMX=y
CONFIG_USB=y
CONFIG_USB_EHCI_POWERDOWN=y
CONFIG_USB_STORAGE=y
CONFIG_VIDEO=y
CONFIG_VIDEO_IPUV3=y
# CONFIG_FAT_ORIG is not set
CONFIG_FAT_FUS=y
CONFIG_OF_LIBFDT=y
# CONFIG_EFI_LOADER is not set
```

## configs/fsimx6sx_defconfig
```kconfig
CONFIG_ARM=y
CONFIG_SYS_THUMB_BUILD=y
CONFIG_ARCH_MX6=y
CONFIG_SYS_TEXT_BASE=0x80100000
CONFIG_TARGET_FSIMX6SX=y
CONFIG_ENV_SIZE=0x4000
CONFIG_ENV_OFFSET=0x0
CONFIG_NR_DRAM_BANKS=1
CONFIG_IDENT_STRING=" for F&S"
CONFIG_FIT=y
CONFIG_OF_BOARD_SETUP=y
CONFIG_SYS_EXTRA_OPTIONS="IMX_CONFIG=board/F+S/fsimx6sx/fsimx6sximage.cfg"
# CONFIG_SET_BOOTDELAY is not set
CONFIG_USE_BOOTARGS=y
CONFIG_BOOTARGS="undef"
# CONFIG_CONSOLE_MUX is not set
CONFIG_SYS_CONSOLE_IS_IN_ENV=y
CONFIG_SYS_CONSOLE_ENV_OVERWRITE=y
CONFIG_HUSH_PARSER=y
CONFIG_CMD_BOOTZ=y
# CONFIG_CMD_ELF is not set
CONFIG_CMD_FSIMAGE_IMX6=y
CONFIG_CMD_ASKENV=y
CONFIG_CMD_INI=y
CONFIG_CMD_ENV_CALLBACK=y
CONFIG_CMD_ENV_FLAGS=y
CONFIG_CMD_MEMTEST=y
CONFIG_CMD_UNZIP=y
# CONFIG_CMD_FLASH is not set
CONFIG_CMD_I2C=y
# CONFIG_CMD_LOADB is not set
# CONFIG_CMD_LOADS is not set
CONFIG_CMD_MMC=y
CONFIG_CMD_NAND=y
CONFIG_CMD_READ=y
CONFIG_CMD_USB=y
CONFIG_CMD_UPDATE=y
CONFIG_CMD_DHCP=y
CONFIG_CMD_MII=y
CONFIG_CMD_PING=y
CONFIG_CMD_CACHE=y
CONFIG_CMD_GETTIME=y
CONFIG_CMD_TIMER=y
CONFIG_CMD_EXT2=y
CONFIG_CMD_EXT4=y
CONFIG_CMD_FAT=y
CONFIG_CMD_FS_GENERIC=y
CONFIG_CMD_MTDPARTS=y
CONFIG_MTDIDS_DEFAULT="undef"
CONFIG_MTDPARTS_DEFAULT="undef"
CONFIG_CMD_UBI=y
CONFIG_ENV_IS_IN_NAND=y
CONFIG_ENV_MMC_EXTRA=y
CONFIG_ENV_MMC_OFFSET=0x100000
CONFIG_ENV_NAND_EXTRA=y
CONFIG_ENV_NAND_OFFSET=0x200000
CONFIG_ENV_NAND_HAVE_RANGE=y
CONFIG_ENV_NAND_RANGE=0x40000
CONFIG_NETCONSOLE=y
CONFIG_SYS_I2C_MXC=y
CONFIG_FSL_USDHC=y
CONFIG_MTD=y
CONFIG_MTD_RAW_NAND=y
CONFIG_NAND_MXS_FUS=y
CONFIG_NAND_REFRESH=y
CONFIG_PHYLIB=y
CONFIG_PHY_ATHEROS=y
CONFIG_PHY_MICREL=y
CONFIG_PHY_NATSEMI=y
CONFIG_FEC_MXC=y
CONFIG_MXC_UART=y
CONFIG_USB=y
CONFIG_USB_EHCI_POWERDOWN=y
CONFIG_USB_STORAGE=y
CONFIG_VIDEO=y
CONFIG_VIDEO_MXS=y
# CONFIG_FAT_ORIG is not set
CONFIG_FAT_FUS=y
CONFIG_OF_LIBFDT=y
# CONFIG_EFI_LOADER is not set
```

## configs/fsimx6ul_defconfig
```kconfig
CONFIG_ARM=y
CONFIG_SYS_THUMB_BUILD=y
# CONFIG_SPL_SYS_THUMB_BUILD is not set
CONFIG_ARCH_MX6=y
CONFIG_SYS_TEXT_BASE=0x80100000
CONFIG_TARGET_FSIMX6UL=y
CONFIG_IDENT_STRING=" for F&S"
CONFIG_FIT=y
CONFIG_OF_BOARD_SETUP=y
CONFIG_SYS_EXTRA_OPTIONS="IMX_CONFIG=board/F+S/fsimx6ul/fsimx6ulimage.cfg"
# CONFIG_SET_BOOTDELAY is not set
CONFIG_USE_BOOTARGS=y
CONFIG_BOOTARGS="undef"
# CONFIG_CONSOLE_MUX is not set
CONFIG_SYS_CONSOLE_IS_IN_ENV=y
CONFIG_SYS_CONSOLE_ENV_OVERWRITE=y
CONFIG_HUSH_PARSER=y
CONFIG_CMD_BOOTZ=y
# CONFIG_CMD_ELF is not set
CONFIG_CMD_FSIMAGE_IMX6=y
CONFIG_CMD_ASKENV=y
CONFIG_CMD_INI=y
CONFIG_CMD_ENV_CALLBACK=y
CONFIG_CMD_ENV_FLAGS=y
CONFIG_CMD_MEMTEST=y
CONFIG_CMD_UNZIP=y
# CONFIG_CMD_FLASH is not set
CONFIG_CMD_I2C=y
# CONFIG_CMD_LOADB is not set
# CONFIG_CMD_LOADS is not set
CONFIG_CMD_MMC=y
CONFIG_CMD_NAND=y
CONFIG_CMD_READ=y
CONFIG_CMD_USB=y
CONFIG_CMD_UPDATE=y
CONFIG_CMD_DHCP=y
CONFIG_CMD_MII=y
CONFIG_CMD_PING=y
CONFIG_CMD_CACHE=y
CONFIG_CMD_GETTIME=y
CONFIG_CMD_TIMER=y
CONFIG_CMD_EXT2=y
CONFIG_CMD_EXT4=y
CONFIG_CMD_FAT=y
CONFIG_CMD_FS_GENERIC=y
CONFIG_MTDIDS_DEFAULT="undef"
CONFIG_MTDPARTS_DEFAULT="undef"
CONFIG_CMD_UBI=y
CONFIG_ENV_IS_IN_MMC=y
CONFIG_ENV_IS_IN_NAND=y
CONFIG_NETCONSOLE=y
CONFIG_SYS_I2C_MXC=y
CONFIG_LED_STATUS0=y
CONFIG_LED_STATUS_BIT=0
CONFIG_LED_STATUS1=y
CONFIG_LED_STATUS_BIT1=1
CONFIG_LED_STATUS_CMD=y
CONFIG_MXC_OCOTP=y
CONFIG_NAND=y
CONFIG_NAND_MXS_FUS=y
CONFIG_NAND_REFRESH=y
CONFIG_PHYLIB=y
CONFIG_MV88E61XX_SWITCH=y
CONFIG_MV88E61XX_88E6020_FAMILY=y
CONFIG_MV88E61XX_CPU_PORT=6
CONFIG_MV88E61XX_REGISTER_OFFSET=0x10
CONFIG_MV88E61XX_PHY_PORTS=0x01F
CONFIG_MV88E61XX_FIXED_PORTS=0x060
CONFIG_PHY_MICREL=y
CONFIG_PHY_NATSEMI=y
CONFIG_NETDEVICES=y
CONFIG_FEC_MXC=y
CONFIG_MXC_UART=y
CONFIG_BLINK_IMX=y
CONFIG_USB=y
CONFIG_USB_EHCI_POWERDOWN=y
CONFIG_USB_STORAGE=y
CONFIG_VIDEO=y
CONFIG_VIDEO_MXS=y
# CONFIG_FAT_ORIG is not set
CONFIG_FAT_FUS=y
CONFIG_OF_LIBFDT=y
# CONFIG_EFI_LOADER is not set
```
